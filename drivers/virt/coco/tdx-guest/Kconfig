## drivers/virt/coco/tdx-guest/Kconfig
```kconfig
config TDX_GUEST_DRIVER
	tristate "TDX Guest driver"
	depends on INTEL_TDX_GUEST
	select TSM_REPORTS
	select TSM_MEASUREMENTS
	help
	  The driver provides userspace interface to communicate with
	  the TDX module to request the TDX guest details like attestation
	  report.

	  To compile this driver as module, choose M here. The module will
	  be called tdx-guest.

config TDX_CONNECT_GUEST
	bool "Intel TDX Connect Guest Support"
	depends on TDX_GUEST_DRIVER
	depends on PCI_TSM
	default y
	help
	  Support Trust Device Interface (TDI) feature enumeration,
	  validation, and activation within an Intel TDX guest.

	  This option enables the guest kernel to establish secure,
	  isolated connections with trusted devices assigned to the TD,
	  validating MMIO maps and authorizing DMA remapping tables.

	  If unsure, say Y.
```
